## dts/bindings/blackberry,bb8250-spi.yaml
```yaml
description: BlackBerry trackpad (SPI)

compatible: "blackberry,trackpad-spi"

include: spi-device.yaml

properties:
    power-pin:
      required: true
      type: int
    reset-pin:
      required: true
      type: int
    motion-pin:
      required: true
      type: int
```
